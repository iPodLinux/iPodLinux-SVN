## linux/vendor/uclinux/current/arch/e1nommu/config.in
```kconfig
#############################################################################
#
# For a description of the syntax of this configuration file,
# see Documentation/kbuild/config-language.txt.
#
# based mainly on the arch/i386/config.in and bit of the 2.4, m68knommu
# config.in
#
#############################################################################

mainmenu_name 'uClinux/Hyperstone (w/o MMU) Kernel Configuration'

define_bool CONFIG_UCLINUX y
define_bool CONFIG_UID16 y
define_bool CONFIG_RWSEM_GENERIC_SPINLOCK y
define_bool CONFIG_RWSEM_XCHGADD_ALGORITHM n

############################################################################
# temporary defines for new features
# (haven't these people heard about feature-freezing within *one* release?)
############################################################################
define_bool CONFIG_RWSEM_GENERIC_SPINLOCK y
define_bool CONFIG_RWSEM_XCHGADD_ALGORITHM n
############################################################################

#############################################################################

mainmenu_option next_comment
comment 'Code maturity level options'
bool 'Prompt for development and/or incomplete code/drivers' CONFIG_EXPERIMENTAL
endmenu

#############################################################################

##mainmenu_option next_comment
##comment 'Loadable module support'
##bool 'Enable loadable module support' CONFIG_MODULES
##if [ "$CONFIG_MODULES" = "y" ]; then
##   bool '  Set version information on all module symbols' CONFIG_MODVERSIONS
##   bool '  Kernel module loader' CONFIG_KMOD
##fi
##endmenu

define_bool CONFIG_MODULES n

#############################################################################

mainmenu_option next_comment
comment 'Processor type and features'

define_bool CONFIG_HYPERSTONE y
define_bool CONFIG_ARCH_HYPERSTONE y

choice 'CPU' \
	"E1-32XS	CONFIG_E132XS \
	 E1-32XN	CONFIG_E132XN" 

comment 'Platform'

if [ "$CONFIG_E132XS" = "y" ]; then
	define_bool CONFIG_E132XS_BOARD y
fi

int 'External Oscillator Frequency in MHz' CONFIG_HYPERSTONE_OSC_FREQ_MHZ 15

choice 'Kernel executes from' \
	"RAM	CONFIG_RAMKERNEL \
	 ROM	CONFIG_ROMKERNEL" RAM

bool 'Extra arguments in the command line' CONFIG_EXTRA_ARGS
if [ "$CONFIG_EXTRA_ARGS" = "y" ]; then
      string "Extra Arguments" CONFIG_EXTRA_ARGS_VARIABLES ""
fi

bool 'Embedded Serial Debug Console' CONFIG_EMBEDDED_SERIAL_CONSOLE
if [ "$CONFIG_EMBEDDED_SERIAL_CONSOLE" = "y" ]; then
	int 'Select chip select number' CONFIG_EMBEDDED_SERIAL_CONSOLE_CS 3
fi

bool 'External devices ?' CONFIG_EXTERNAL_DEVICES

if [ "$CONFIG_EXTERNAL_DEVICES" = "y" ]; then
bool 'I/O access to external devices' CONFIG_IO_ACCESS
bool 'Enable E132XS CS89x0 Ethernet' CONFIG_HYPERSTONE_CS89X0
if [ "$CONFIG_HYPERSTONE_CS89X0" = "y" ]; then
	int 'Interrupt line number' CONFIG_HYPERSTONE_CS89X0_IRQ "1"
   if [ "$CONFIG_IP_PNP" = "y" ]; then
      string "Board IP" CONFIG_E132XS_BOARD_NET_BOARD_IP ""
      string "Hostname" CONFIG_E132XS_BOARD_NET_HOSTNAME ""
      string "Default Gateway" CONFIG_E132XS_BOARD_NET_DEFAULTGW ""
      string "Netmask" CONFIG_E132XS_BOARD_NET_NETMASK ""
   fi
if [ "$CONFIG_IP_PNP" = "y" ]; then
   # root on NFS enabled?
   if [ "$CONFIG_ROOT_NFS" = "y" ]; then
      string "NFS server:/root,options" CONFIG_E132XS_BOARD_NET_NFS_ROOT ""
   fi
fi

fi
fi

endmenu

#############################################################################

mainmenu_option next_comment
comment 'General setup'

bool 'Networking support' CONFIG_NET
bool 'SGI Visual Workstation support' CONFIG_VISWS
define_bool CONFIG_VISWS n
if [ "$CONFIG_VISWS" = "y" ]; then
   define_bool CONFIG_X86_VISWS_APIC y
   define_bool CONFIG_X86_LOCAL_APIC y
   define_bool CONFIG_PCI y
else
   if [ "$CONFIG_SMP" = "y" ]; then
      define_bool CONFIG_X86_IO_APIC y
      define_bool CONFIG_X86_LOCAL_APIC y
   fi
   bool 'PCI support' CONFIG_PCI
   define_bool CONFIG_PCI n
   if [ "$CONFIG_PCI" = "y" ]; then
      choice '  PCI access mode' \
	"BIOS		CONFIG_PCI_GOBIOS	\
	 Direct		CONFIG_PCI_GODIRECT	\
	 Any		CONFIG_PCI_GOANY"	Any
      if [ "$CONFIG_PCI_GOBIOS" = "y" -o "$CONFIG_PCI_GOANY" = "y" ]; then
         define_bool CONFIG_PCI_BIOS y
      fi
      if [ "$CONFIG_PCI_GODIRECT" = "y" -o "$CONFIG_PCI_GOANY" = "y" ]; then
         define_bool CONFIG_PCI_DIRECT y
      fi
   fi
fi

source drivers/pci/Config.in

if [ "$CONFIG_VISWS" != "y" ]; then
   bool 'MCA support' CONFIG_MCA
fi

bool 'Support for hot-pluggable devices' CONFIG_HOTPLUG

if [ "$CONFIG_HOTPLUG" = "y" ] ; then
   source drivers/pcmcia/Config.in
else
   define_bool CONFIG_PCMCIA n
fi

bool 'System V IPC' CONFIG_SYSVIPC
bool 'BSD Process Accounting' CONFIG_BSD_PROCESS_ACCT
bool 'Sysctl support' CONFIG_SYSCTL
define_bool CONFIG_SYSCTL n
if [ "$CONFIG_PROC_FS" = "y" ]; then
   choice 'Kernel core (/proc/kcore) format' \
	"ELF		CONFIG_KCORE_ELF	\
	 A.OUT		CONFIG_KCORE_AOUT" ELF
fi
tristate 'Kernel support for flat binaries' CONFIG_BINFMT_FLAT
tristate 'Kernel support for a.out binaries' CONFIG_BINFMT_AOUT
tristate 'Kernel support for ELF binaries' CONFIG_BINFMT_ELF y
tristate 'Kernel support for MISC binaries' CONFIG_BINFMT_MISC

bool 'Power Management support' CONFIG_PM

dep_bool '  ACPI support' CONFIG_ACPI $CONFIG_PM
if [ "$CONFIG_ACPI" != "n" ]; then
   if [ "$CONFIG_EXPERIMENTAL" = "y" ]; then
      bool '    ACPI interpreter (EXPERIMENTAL)' CONFIG_ACPI_INTERPRETER
      bool '    Enter S1 for sleep (EXPERIMENTAL)' CONFIG_ACPI_S1_SLEEP
   fi
fi

dep_tristate '  Advanced Power Management BIOS support' CONFIG_APM $CONFIG_PM
if [ "$CONFIG_APM" != "n" ]; then
   bool '    Ignore USER SUSPEND' CONFIG_APM_IGNORE_USER_SUSPEND
   bool '    Enable PM at boot time' CONFIG_APM_DO_ENABLE
   bool '    Make CPU Idle calls when idle' CONFIG_APM_CPU_IDLE
   bool '    Enable console blanking using APM' CONFIG_APM_DISPLAY_BLANK
   bool '    RTC stores time in GMT' CONFIG_APM_RTC_IS_GMT
   bool '    Allow interrupts during APM BIOS calls' CONFIG_APM_ALLOW_INTS
   bool '    Use real mode APM BIOS call to power off' CONFIG_APM_REAL_MODE_POWER_OFF
fi

endmenu

#############################################################################

source drivers/mtd/Config.in

source drivers/parport/Config.in

source drivers/pnp/Config.in

source drivers/block/Config.in

if [ "$CONFIG_NET" = "y" ]; then
   source net/Config.in
fi

source drivers/telephony/Config.in

#############################################################################

mainmenu_option next_comment
comment 'ATA/IDE/MFM/RLL support'

tristate 'ATA/IDE/MFM/RLL support' CONFIG_IDE

if [ "$CONFIG_IDE" != "n" ]; then
  source drivers/ide/Config.in
else
  define_bool CONFIG_BLK_DEV_IDE_MODES n
  define_bool CONFIG_BLK_DEV_HD n
fi
endmenu

#############################################################################

mainmenu_option next_comment
comment 'SCSI support'

tristate 'SCSI support' CONFIG_SCSI

if [ "$CONFIG_SCSI" != "n" ]; then
   source drivers/scsi/Config.in
fi
endmenu

#############################################################################

source drivers/ieee1394/Config.in

source drivers/message/i2o/Config.in

if [ "$CONFIG_NET" = "y" ]; then
   mainmenu_option next_comment
   comment 'Network device support'

   bool 'Network device support' CONFIG_NETDEVICES
   if [ "$CONFIG_NETDEVICES" = "y" ]; then
      source drivers/net/Config.in
      if [ "$CONFIG_ATM" = "y" ]; then
         source drivers/atm/Config.in
      fi
   fi
   endmenu
fi

source net/ax25/Config.in

source net/irda/Config.in

#############################################################################

mainmenu_option next_comment
comment 'ISDN subsystem'
if [ "$CONFIG_NET" != "n" ]; then
   tristate 'ISDN support' CONFIG_ISDN
   if [ "$CONFIG_ISDN" != "n" ]; then
      source drivers/isdn/Config.in
   fi
fi
endmenu

#############################################################################

mainmenu_option next_comment
comment 'Old CD-ROM drivers (not SCSI, not IDE)'

 bool 'Support non-SCSI/IDE/ATAPI CDROM drives' CONFIG_CD_NO_IDESCSI
define_bool CONFIG_CD_NO_IDESCSI n
if [ "$CONFIG_CD_NO_IDESCSI" != "n" ]; then
   source drivers/cdrom/Config.in
fi
endmenu

#############################################################################

source drivers/char/Config.in


#source drivers/misc/Config.in

source fs/Config.in

if [ "$CONFIG_VT" = "y" ]; then
   mainmenu_option next_comment
   comment 'Console drivers'
   bool 'VGA text console' CONFIG_VGA_CONSOLE
   define_bool CONFIG_VGA_CONSOLE n
   bool 'Video mode selection support' CONFIG_VIDEO_SELECT
   define_bool CONFIG_VIDEO_SELECT n
   if [ "$CONFIG_EXPERIMENTAL" = "y" ]; then
      tristate 'MDA text console (dual-headed) (EXPERIMENTAL)' CONFIG_MDA_CONSOLE
      source drivers/video/Config.in
   fi
   endmenu
fi

#############################################################################

mainmenu_option next_comment
comment 'Sound'

tristate 'Sound card support' CONFIG_SOUND
if [ "$CONFIG_SOUND" != "n" ]; then
   source drivers/sound/Config.in
fi
endmenu

#############################################################################

source drivers/usb/Config.in

#############################################################################

mainmenu_option next_comment
comment 'Kernel hacking'

bool 'Full Symbolic/Source Debugging support' CONFIG_FULLDEBUG
#bool 'Debug kmalloc/kfree' CONFIG_DEBUG_MALLOC
bool 'Magic SysRq key' CONFIG_MAGIC_SYSRQ
if [ "$CONFIG_EXPERIMENTAL" = "y" ]; then
	bool 'Non power-of-2 kernel allocator (EXPERIMENTAL)' CONFIG_CONTIGUOUS_PAGE_ALLOC
	dep_bool '  include /proc/mem_map' CONFIG_MEM_MAP $CONFIG_CONTIGUOUS_PAGE_ALLOC
fi

bool 'Kernel profiling support' CONFIG_PROFILE
if [ "$CONFIG_PROFILE" = "y" ]; then
  int ' Profile shift count' CONFIG_PROFILE_SHIFT 2
  bool 'Use fast second timer for profiling' CONFIG_HIGHPROFILE
fi

if [ "$CONFIG_COLDFIRE" = "y" ]; then
	bool 'Panic/Dump to FLASH' CONFIG_DUMPTOFLASH
fi

bool 'Suppress Kernel BUG Messages' CONFIG_NO_KERNEL_MSG

bool 'Reduce kernel task size to 1 page' CONFIG_SMALL_TASKS

if [ "$CONFIG_EXPERIMENTAL" = "y" -a "$CONFIG_COLDFIRE" = "y" -a "$CONFIG_FULLDEBUG" = "n" ]; then
    bool 'Disable BDM signals' CONFIG_BDM_DISABLE
fi

endmenu


#############################################################################

source lib/Config.in

#############################################################################
```
