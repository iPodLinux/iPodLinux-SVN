## linux/vendor/uclinux/2.4.24/drivers/i2c/Config.in
```kconfig
#
# Character device configuration
#
mainmenu_option next_comment
comment 'I2C support'

tristate 'I2C support' CONFIG_I2C

if [ "$CONFIG_I2C" != "n" ]; then

   dep_tristate 'I2C bit-banging interfaces'  CONFIG_I2C_ALGOBIT $CONFIG_I2C
   if [ "$CONFIG_I2C_ALGOBIT" != "n" ]; then
      dep_tristate '  Philips style parallel port adapter' CONFIG_I2C_PHILIPSPAR $CONFIG_I2C_ALGOBIT $CONFIG_PARPORT
      dep_tristate '  ELV adapter' CONFIG_I2C_ELV $CONFIG_I2C_ALGOBIT
      dep_tristate '  Velleman K9000 adapter' CONFIG_I2C_VELLEMAN $CONFIG_I2C_ALGOBIT
      dep_tristate '  Motorola Coldfire GPIO adapter (EXPERIMENTAL)' CONFIG_I2C_MCF_GPIO $CONFIG_I2C_ALGOBIT $CONFIG_COLDFIRE $CONFIG_EXPERIMENTAL
      if [ "$CONFIG_I2C_MCF_GPIO" != "n" ]; then
	 if [ "$CONFIG_M5204" = "y" -o "$CONFIG_M5206" = "y" -o "$CONFIG_M5206e" = "y" ]; then
	    comment 'M5204, M5206 and M5206e GPIO support'
	    choice 'SDA GPIO pin' "PP0 CONFIG_I2C_MCF_GPIO_SDA_PP0 \
				   PP1 CONFIG_I2C_MCF_GPIO_SDA_PP1 \
				   PP2 CONFIG_I2C_MCF_GPIO_SDA_PP2 \
				   PP3 CONFIG_I2C_MCF_GPIO_SDA_PP3 \
				   PP4 CONFIG_I2C_MCF_GPIO_SDA_PP4 \
				   PP5 CONFIG_I2C_MCF_GPIO_SDA_PP5 \
				   PP6 CONFIG_I2C_MCF_GPIO_SDA_PP6 \
				   PP7 CONFIG_I2C_MCF_GPIO_SDA_PP7" PP0
	    choice 'SCL GPIO pin' "PP0 CONFIG_I2C_MCF_GPIO_SCL_PP0 \
				   PP1 CONFIG_I2C_MCF_GPIO_SCL_PP1 \
				   PP2 CONFIG_I2C_MCF_GPIO_SCL_PP2 \
				   PP3 CONFIG_I2C_MCF_GPIO_SCL_PP3 \
				   PP4 CONFIG_I2C_MCF_GPIO_SCL_PP4 \
				   PP5 CONFIG_I2C_MCF_GPIO_SCL_PP5 \
				   PP6 CONFIG_I2C_MCF_GPIO_SCL_PP6 \
				   PP7 CONFIG_I2C_MCF_GPIO_SCL_PP7" PP1
	 fi
	 if [ "$CONFIG_M5249" = "y" ]; then
	    comment 'M5249 GPIO support'
	    choice 'SDA GPIO pin' "GPIO0 CONFIG_I2C_MCF_GPIO_SDA_GPIO0 \
				   GPIO1 CONFIG_I2C_MCF_GPIO_SDA_GPIO1 \
				   GPIO2 CONFIG_I2C_MCF_GPIO_SDA_GPIO2 \
				   GPIO3 CONFIG_I2C_MCF_GPIO_SDA_GPIO3 \
				   GPIO4 CONFIG_I2C_MCF_GPIO_SDA_GPIO4 \
				   GPIO5 CONFIG_I2C_MCF_GPIO_SDA_GPIO5 \
				   GPIO6 CONFIG_I2C_MCF_GPIO_SDA_GPIO6 \
				   GPIO7 CONFIG_I2C_MCF_GPIO_SDA_GPIO7 \
				   GPIO9 CONFIG_I2C_MCF_GPIO_SDA_GPIO9 \
				   GPIO10 CONFIG_I2C_MCF_GPIO_SDA_GPIO10 \
				   GPIO11 CONFIG_I2C_MCF_GPIO_SDA_GPIO11 \
				   GPIO12 CONFIG_I2C_MCF_GPIO_SDA_GPIO12 \
				   GPIO13 CONFIG_I2C_MCF_GPIO_SDA_GPIO13 \
				   GPIO14 CONFIG_I2C_MCF_GPIO_SDA_GPIO14 \
				   GPIO15 CONFIG_I2C_MCF_GPIO_SDA_GPIO15 \
				   GPIO16 CONFIG_I2C_MCF_GPIO_SDA_GPIO16 \
				   GPIO17 CONFIG_I2C_MCF_GPIO_SDA_GPIO17 \
				   GPIO18 CONFIG_I2C_MCF_GPIO_SDA_GPIO18 \
				   GPIO19 CONFIG_I2C_MCF_GPIO_SDA_GPIO19 \
				   GPIO20 CONFIG_I2C_MCF_GPIO_SDA_GPIO20 \
				   GPIO21 CONFIG_I2C_MCF_GPIO_SDA_GPIO21 \
				   GPIO22 CONFIG_I2C_MCF_GPIO_SDA_GPIO22 \
				   GPIO23 CONFIG_I2C_MCF_GPIO_SDA_GPIO23 \
				   GPIO24 CONFIG_I2C_MCF_GPIO_SDA_GPIO24 \
				   GPIO25 CONFIG_I2C_MCF_GPIO_SDA_GPIO25 \
				   GPIO26 CONFIG_I2C_MCF_GPIO_SDA_GPIO26 \
				   GPIO29 CONFIG_I2C_MCF_GPIO_SDA_GPIO29 \
				   GPIO33 CONFIG_I2C_MCF_GPIO_SDA_GPIO33 \
				   GPIO34 CONFIG_I2C_MCF_GPIO_SDA_GPIO34 \
				   GPIO44 CONFIG_I2C_MCF_GPIO_SDA_GPIO44 \
				   GPIO45 CONFIG_I2C_MCF_GPIO_SDA_GPIO45 \
				   GPIO46 CONFIG_I2C_MCF_GPIO_SDA_GPIO46 \
				   GPIO48 CONFIG_I2C_MCF_GPIO_SDA_GPIO48 \
				   GPIO49 CONFIG_I2C_MCF_GPIO_SDA_GPIO49 \
				   GPIO50 CONFIG_I2C_MCF_GPIO_SDA_GPIO50 \
				   GPIO51 CONFIG_I2C_MCF_GPIO_SDA_GPIO51 \
				   GPIO52 CONFIG_I2C_MCF_GPIO_SDA_GPIO52 \
				   GPIO53 CONFIG_I2C_MCF_GPIO_SDA_GPIO53 \
				   GPIO54 CONFIG_I2C_MCF_GPIO_SDA_GPIO54 \
				   GPIO55 CONFIG_I2C_MCF_GPIO_SDA_GPIO55 \
				   GPIO56 CONFIG_I2C_MCF_GPIO_SDA_GPIO56 \
				   GPIO57 CONFIG_I2C_MCF_GPIO_SDA_GPIO57 \
				   GPIO58 CONFIG_I2C_MCF_GPIO_SDA_GPIO58 \
				   GPIO59 CONFIG_I2C_MCF_GPIO_SDA_GPIO59 \
				   GPIO60 CONFIG_I2C_MCF_GPIO_SDA_GPIO60 \
				   GPIO61 CONFIG_I2C_MCF_GPIO_SDA_GPIO61 \
				   GPIO62 CONFIG_I2C_MCF_GPIO_SDA_GPIO62" \
				   GPIO0
	    choice 'SCL GPIO pin' "GPIO0 CONFIG_I2C_MCF_GPIO_SCL_GPIO0 \
				   GPIO1 CONFIG_I2C_MCF_GPIO_SCL_GPIO1 \
				   GPIO2 CONFIG_I2C_MCF_GPIO_SCL_GPIO2 \
				   GPIO3 CONFIG_I2C_MCF_GPIO_SCL_GPIO3 \
				   GPIO4 CONFIG_I2C_MCF_GPIO_SCL_GPIO4 \
				   GPIO5 CONFIG_I2C_MCF_GPIO_SCL_GPIO5 \
				   GPIO6 CONFIG_I2C_MCF_GPIO_SCL_GPIO6 \
				   GPIO7 CONFIG_I2C_MCF_GPIO_SCL_GPIO7 \
				   GPIO9 CONFIG_I2C_MCF_GPIO_SCL_GPIO9 \
				   GPIO10 CONFIG_I2C_MCF_GPIO_SCL_GPIO10 \
				   GPIO11 CONFIG_I2C_MCF_GPIO_SCL_GPIO11 \
				   GPIO12 CONFIG_I2C_MCF_GPIO_SCL_GPIO12 \
				   GPIO13 CONFIG_I2C_MCF_GPIO_SCL_GPIO13 \
				   GPIO14 CONFIG_I2C_MCF_GPIO_SCL_GPIO14 \
				   GPIO15 CONFIG_I2C_MCF_GPIO_SCL_GPIO15 \
				   GPIO16 CONFIG_I2C_MCF_GPIO_SCL_GPIO16 \
				   GPIO17 CONFIG_I2C_MCF_GPIO_SCL_GPIO17 \
				   GPIO18 CONFIG_I2C_MCF_GPIO_SCL_GPIO18 \
				   GPIO19 CONFIG_I2C_MCF_GPIO_SCL_GPIO19 \
				   GPIO20 CONFIG_I2C_MCF_GPIO_SCL_GPIO20 \
				   GPIO21 CONFIG_I2C_MCF_GPIO_SCL_GPIO21 \
				   GPIO22 CONFIG_I2C_MCF_GPIO_SCL_GPIO22 \
				   GPIO23 CONFIG_I2C_MCF_GPIO_SCL_GPIO23 \
				   GPIO24 CONFIG_I2C_MCF_GPIO_SCL_GPIO24 \
				   GPIO25 CONFIG_I2C_MCF_GPIO_SCL_GPIO25 \
				   GPIO26 CONFIG_I2C_MCF_GPIO_SCL_GPIO26 \
				   GPIO29 CONFIG_I2C_MCF_GPIO_SCL_GPIO29 \
				   GPIO33 CONFIG_I2C_MCF_GPIO_SCL_GPIO33 \
				   GPIO34 CONFIG_I2C_MCF_GPIO_SCL_GPIO34 \
				   GPIO44 CONFIG_I2C_MCF_GPIO_SCL_GPIO44 \
				   GPIO45 CONFIG_I2C_MCF_GPIO_SCL_GPIO45 \
				   GPIO46 CONFIG_I2C_MCF_GPIO_SCL_GPIO46 \
				   GPIO48 CONFIG_I2C_MCF_GPIO_SCL_GPIO48 \
				   GPIO49 CONFIG_I2C_MCF_GPIO_SCL_GPIO49 \
				   GPIO50 CONFIG_I2C_MCF_GPIO_SCL_GPIO50 \
				   GPIO51 CONFIG_I2C_MCF_GPIO_SCL_GPIO51 \
				   GPIO52 CONFIG_I2C_MCF_GPIO_SCL_GPIO52 \
				   GPIO53 CONFIG_I2C_MCF_GPIO_SCL_GPIO53 \
				   GPIO54 CONFIG_I2C_MCF_GPIO_SCL_GPIO54 \
				   GPIO55 CONFIG_I2C_MCF_GPIO_SCL_GPIO55 \
				   GPIO56 CONFIG_I2C_MCF_GPIO_SCL_GPIO56 \
				   GPIO57 CONFIG_I2C_MCF_GPIO_SCL_GPIO57 \
				   GPIO58 CONFIG_I2C_MCF_GPIO_SCL_GPIO58 \
				   GPIO59 CONFIG_I2C_MCF_GPIO_SCL_GPIO59 \
				   GPIO60 CONFIG_I2C_MCF_GPIO_SCL_GPIO60 \
				   GPIO61 CONFIG_I2C_MCF_GPIO_SCL_GPIO61 \
				   GPIO62 CONFIG_I2C_MCF_GPIO_SCL_GPIO62" \
				   GPIO1
	 fi
	 if [ "$CONFIG_M5272" = "y" ]; then
	    comment 'M5272 GPIO support'
	    choice 'SDA GPIO pin' "PA0 CONFIG_I2C_MCF_GPIO_SDA_PA0 \
				   PA1 CONFIG_I2C_MCF_GPIO_SDA_PA1 \
				   PA2 CONFIG_I2C_MCF_GPIO_SDA_PA2 \
				   PA3 CONFIG_I2C_MCF_GPIO_SDA_PA3 \
				   PA4 CONFIG_I2C_MCF_GPIO_SDA_PA4 \
				   PA5 CONFIG_I2C_MCF_GPIO_SDA_PA5 \
				   PA6 CONFIG_I2C_MCF_GPIO_SDA_PA6 \
				   PA7 CONFIG_I2C_MCF_GPIO_SDA_PA7 \
				   PA8 CONFIG_I2C_MCF_GPIO_SDA_PA8 \
				   PA9 CONFIG_I2C_MCF_GPIO_SDA_PA9 \
				   PA10 CONFIG_I2C_MCF_GPIO_SDA_PA10 \
				   PA11 CONFIG_I2C_MCF_GPIO_SDA_PA11 \
				   PA12 CONFIG_I2C_MCF_GPIO_SDA_PA12 \
				   PA13 CONFIG_I2C_MCF_GPIO_SDA_PA13 \
				   PA14 CONFIG_I2C_MCF_GPIO_SDA_PA14 \
				   PA15 CONFIG_I2C_MCF_GPIO_SDA_PA15 \
				   PB0 CONFIG_I2C_MCF_GPIO_SDA_PB0 \
				   PB1 CONFIG_I2C_MCF_GPIO_SDA_PB1 \
				   PB2 CONFIG_I2C_MCF_GPIO_SDA_PB2 \
				   PB3 CONFIG_I2C_MCF_GPIO_SDA_PB3 \
				   PB4 CONFIG_I2C_MCF_GPIO_SDA_PB4 \
				   PB5 CONFIG_I2C_MCF_GPIO_SDA_PB5 \
				   PB6 CONFIG_I2C_MCF_GPIO_SDA_PB6 \
				   PB7 CONFIG_I2C_MCF_GPIO_SDA_PB7 \
				   PB8 CONFIG_I2C_MCF_GPIO_SDA_PB8 \
				   PB9 CONFIG_I2C_MCF_GPIO_SDA_PB9 \
				   PB10 CONFIG_I2C_MCF_GPIO_SDA_PB10 \
				   PB11 CONFIG_I2C_MCF_GPIO_SDA_PB11 \
				   PB12 CONFIG_I2C_MCF_GPIO_SDA_PB12 \
				   PB13 CONFIG_I2C_MCF_GPIO_SDA_PB13 \
				   PB14 CONFIG_I2C_MCF_GPIO_SDA_PB14 \
				   PB15 CONFIG_I2C_MCF_GPIO_SDA_PB15 \
				   PC0 CONFIG_I2C_MCF_GPIO_SDA_PC0 \
				   PC1 CONFIG_I2C_MCF_GPIO_SDA_PC1 \
				   PC2 CONFIG_I2C_MCF_GPIO_SDA_PC2 \
				   PC3 CONFIG_I2C_MCF_GPIO_SDA_PC3 \
				   PC4 CONFIG_I2C_MCF_GPIO_SDA_PC4 \
				   PC5 CONFIG_I2C_MCF_GPIO_SDA_PC5 \
				   PC6 CONFIG_I2C_MCF_GPIO_SDA_PC6 \
				   PC7 CONFIG_I2C_MCF_GPIO_SDA_PC7 \
				   PC8 CONFIG_I2C_MCF_GPIO_SDA_PC8 \
				   PC9 CONFIG_I2C_MCF_GPIO_SDA_PC9 \
				   PC10 CONFIG_I2C_MCF_GPIO_SDA_PC10 \
				   PC11 CONFIG_I2C_MCF_GPIO_SDA_PC11 \
				   PC12 CONFIG_I2C_MCF_GPIO_SDA_PC12 \
				   PC13 CONFIG_I2C_MCF_GPIO_SDA_PC13 \
				   PC14 CONFIG_I2C_MCF_GPIO_SDA_PC14 \
				   PC15 CONFIG_I2C_MCF_GPIO_SDA_PC15" PA0
	    choice 'SCL GPIO pin' "PA0 CONFIG_I2C_MCF_GPIO_SCL_PA0 \
				   PA1 CONFIG_I2C_MCF_GPIO_SCL_PA1 \
				   PA2 CONFIG_I2C_MCF_GPIO_SCL_PA2 \
				   PA3 CONFIG_I2C_MCF_GPIO_SCL_PA3 \
				   PA4 CONFIG_I2C_MCF_GPIO_SCL_PA4 \
				   PA5 CONFIG_I2C_MCF_GPIO_SCL_PA5 \
				   PA6 CONFIG_I2C_MCF_GPIO_SCL_PA6 \
				   PA7 CONFIG_I2C_MCF_GPIO_SCL_PA7 \
				   PA8 CONFIG_I2C_MCF_GPIO_SCL_PA8 \
				   PA9 CONFIG_I2C_MCF_GPIO_SCL_PA9 \
				   PA10 CONFIG_I2C_MCF_GPIO_SCL_PA10 \
				   PA11 CONFIG_I2C_MCF_GPIO_SCL_PA11 \
				   PA12 CONFIG_I2C_MCF_GPIO_SCL_PA12 \
				   PA13 CONFIG_I2C_MCF_GPIO_SCL_PA13 \
				   PA14 CONFIG_I2C_MCF_GPIO_SCL_PA14 \
				   PA15 CONFIG_I2C_MCF_GPIO_SCL_PA15 \
				   PB0 CONFIG_I2C_MCF_GPIO_SCL_PB0 \
				   PB1 CONFIG_I2C_MCF_GPIO_SCL_PB1 \
				   PB2 CONFIG_I2C_MCF_GPIO_SCL_PB2 \
				   PB3 CONFIG_I2C_MCF_GPIO_SCL_PB3 \
				   PB4 CONFIG_I2C_MCF_GPIO_SCL_PB4 \
				   PB5 CONFIG_I2C_MCF_GPIO_SCL_PB5 \
				   PB6 CONFIG_I2C_MCF_GPIO_SCL_PB6 \
				   PB7 CONFIG_I2C_MCF_GPIO_SCL_PB7 \
				   PB8 CONFIG_I2C_MCF_GPIO_SCL_PB8 \
				   PB9 CONFIG_I2C_MCF_GPIO_SCL_PB9 \
				   PB10 CONFIG_I2C_MCF_GPIO_SCL_PB10 \
				   PB11 CONFIG_I2C_MCF_GPIO_SCL_PB11 \
				   PB12 CONFIG_I2C_MCF_GPIO_SCL_PB12 \
				   PB13 CONFIG_I2C_MCF_GPIO_SCL_PB13 \
				   PB14 CONFIG_I2C_MCF_GPIO_SCL_PB14 \
				   PB15 CONFIG_I2C_MCF_GPIO_SCL_PB15 \
				   PC0 CONFIG_I2C_MCF_GPIO_SCL_PC0 \
				   PC1 CONFIG_I2C_MCF_GPIO_SCL_PC1 \
				   PC2 CONFIG_I2C_MCF_GPIO_SCL_PC2 \
				   PC3 CONFIG_I2C_MCF_GPIO_SCL_PC3 \
				   PC4 CONFIG_I2C_MCF_GPIO_SCL_PC4 \
				   PC5 CONFIG_I2C_MCF_GPIO_SCL_PC5 \
				   PC6 CONFIG_I2C_MCF_GPIO_SCL_PC6 \
				   PC7 CONFIG_I2C_MCF_GPIO_SCL_PC7 \
				   PC8 CONFIG_I2C_MCF_GPIO_SCL_PC8 \
				   PC9 CONFIG_I2C_MCF_GPIO_SCL_PC9 \
				   PC10 CONFIG_I2C_MCF_GPIO_SCL_PC10 \
				   PC11 CONFIG_I2C_MCF_GPIO_SCL_PC11 \
				   PC12 CONFIG_I2C_MCF_GPIO_SCL_PC12 \
				   PC13 CONFIG_I2C_MCF_GPIO_SCL_PC13 \
				   PC14 CONFIG_I2C_MCF_GPIO_SCL_PC14 \
				   PC15 CONFIG_I2C_MCF_GPIO_SCL_PC15" PA1
	 fi
	 if [ "$CONFIG_M5307" = "y" -o "$CONFIG_M5407" = "y" ]; then
	    comment 'M5307 and M5407 GPIO support'
	    choice 'SDA GPIO pin' "PP0 CONFIG_I2C_MCF_GPIO_SDA_PP0 \
				   PP1 CONFIG_I2C_MCF_GPIO_SDA_PP1 \
				   PP2 CONFIG_I2C_MCF_GPIO_SDA_PP2 \
				   PP3 CONFIG_I2C_MCF_GPIO_SDA_PP3 \
				   PP4 CONFIG_I2C_MCF_GPIO_SDA_PP4 \
				   PP5 CONFIG_I2C_MCF_GPIO_SDA_PP5 \
				   PP6 CONFIG_I2C_MCF_GPIO_SDA_PP6 \
				   PP7 CONFIG_I2C_MCF_GPIO_SDA_PP7 \
				   PP8 CONFIG_I2C_MCF_GPIO_SDA_PP8 \
				   PP9 CONFIG_I2C_MCF_GPIO_SDA_PP9 \
				   PP10 CONFIG_I2C_MCF_GPIO_SDA_PP10 \
				   PP11 CONFIG_I2C_MCF_GPIO_SDA_PP11 \
				   PP12 CONFIG_I2C_MCF_GPIO_SDA_PP12 \
				   PP13 CONFIG_I2C_MCF_GPIO_SDA_PP13 \
				   PP14 CONFIG_I2C_MCF_GPIO_SDA_PP14 \
				   PP15 CONFIG_I2C_MCF_GPIO_SDA_PP15" PP0
	    choice 'SCL GPIO pin' "PP0 CONFIG_I2C_MCF_GPIO_SCL_PP0 \
				   PP1 CONFIG_I2C_MCF_GPIO_SCL_PP1 \
				   PP2 CONFIG_I2C_MCF_GPIO_SCL_PP2 \
				   PP3 CONFIG_I2C_MCF_GPIO_SCL_PP3 \
				   PP4 CONFIG_I2C_MCF_GPIO_SCL_PP4 \
				   PP5 CONFIG_I2C_MCF_GPIO_SCL_PP5 \
				   PP6 CONFIG_I2C_MCF_GPIO_SCL_PP6 \
				   PP7 CONFIG_I2C_MCF_GPIO_SCL_PP7 \
				   PP8 CONFIG_I2C_MCF_GPIO_SCL_PP8 \
				   PP9 CONFIG_I2C_MCF_GPIO_SCL_PP9 \
				   PP10 CONFIG_I2C_MCF_GPIO_SCL_PP10 \
				   PP11 CONFIG_I2C_MCF_GPIO_SCL_PP11 \
				   PP12 CONFIG_I2C_MCF_GPIO_SCL_PP12 \
				   PP13 CONFIG_I2C_MCF_GPIO_SCL_PP13 \
				   PP14 CONFIG_I2C_MCF_GPIO_SCL_PP14 \
				   PP15 CONFIG_I2C_MCF_GPIO_SCL_PP15" PP1
	 fi
         if [ "$CONFIG_M5282" = "y" -o "$CONFIG_M5280" = "y" ]; then
            comment 'MCF5282/MCF5280 GPIO I2C not currently supported'
         fi
      fi
      dep_tristate '  NatSemi SCx200 I2C using GPIO pins' CONFIG_SCx200_I2C $CONFIG_SCx200 $CONFIG_I2C_ALGOBIT
      if [ "$CONFIG_SCx200_I2C" != "n" ]; then
         int  '    GPIO pin used for SCL' CONFIG_SCx200_I2C_SCL 12
         int  '    GPIO pin used for SDA' CONFIG_SCx200_I2C_SDA 13
      fi
      dep_tristate '  NatSemi SCx200 ACCESS.bus' CONFIG_SCx200_ACB $CONFIG_I2C
   fi

   dep_tristate 'I2C PCF 8584 interfaces' CONFIG_I2C_ALGOPCF $CONFIG_I2C
   if [ "$CONFIG_I2C_ALGOPCF" != "n" ]; then
      dep_tristate '  Elektor ISA card' CONFIG_I2C_ELEKTOR $CONFIG_I2C_ALGOPCF
   fi

   if [ "$CONFIG_MIPS_ITE8172" = "y" ]; then
      dep_tristate 'ITE I2C Algorithm' CONFIG_ITE_I2C_ALGO $CONFIG_I2C
      if [ "$CONFIG_ITE_I2C_ALGO" != "n" ]; then
         dep_tristate '  ITE I2C Adapter' CONFIG_ITE_I2C_ADAP $CONFIG_ITE_I2C_ALGO
      fi
   fi
   if [ "$CONFIG_8xx" = "y" ]; then
      dep_tristate 'MPC8xx CPM I2C interface' CONFIG_I2C_ALGO8XX $CONFIG_I2C
      if [ "$CONFIG_RPXLITE" = "y" -o "$CONFIG_RPXCLASSIC" = "y" ]; then
         dep_tristate '  Embedded Planet RPX Lite/Classic suppoort' CONFIG_I2C_RPXLITE $CONFIG_I2C_ALGO8XX
      fi
   fi
   if [ "$CONFIG_405" = "y" ]; then
      dep_tristate 'PPC 405 I2C Algorithm' CONFIG_I2C_PPC405_ALGO $CONFIG_I2C
      if [ "$CONFIG_I2C_PPC405_ALGO" != "n" ]; then
         dep_tristate '  PPC 405 I2C Adapter' CONFIG_I2C_PPC405_ADAP $CONFIG_I2C_PPC405_ALGO
      fi
   fi

   if [ "$CONFIG_ALL_PPC" = "y" ] ; then
      dep_tristate 'Keywest I2C interface in Apple Core99 machines' CONFIG_I2C_KEYWEST $CONFIG_I2C
   fi

   if [ "$CONFIG_SIBYTE_SB1xxx_SOC" = "y" ]; then
      dep_tristate 'SiByte SMBus interface' CONFIG_I2C_ALGO_SIBYTE $CONFIG_I2C
      dep_tristate '  MAX1617 Temperature Sensor' CONFIG_I2C_MAX1617 $CONFIG_I2C_ALGO_SIBYTE
   fi

# This is needed for automatic patch generation: sensors code starts here
# This is needed for automatic patch generation: sensors code ends here

   dep_tristate 'I2C device interface' CONFIG_I2C_CHARDEV $CONFIG_I2C
   dep_tristate 'I2C /proc interface (required for hardware sensors)' CONFIG_I2C_PROC $CONFIG_I2C

fi
endmenu
```
